/*
* 7 segment display
* Schematic based on http://en.wikipedia.org/wiki/Seven-segment_display
Hoo-ray for ASCII art! Scroll down for all those who are too lazy to find the schematics for a 7 segment display.             
*/
#include <Ethernet.h>
#include <SPI.h>
#include <HashMap.h>

//const int SEVEN_SEGMENT_PINS[][8] = {{a, b, c, d, e, f, g, dp}, ...};
const int SEVEN_SEGMENT_PINS[][8] = {{22, 23, 24, 25, 26, 27, 28, 29}, {32, 33, 34, 35, 36, 37, 38, 39}, {42, 43, 44, 45, 46, 47, 48, 49}};

const byte DOT = B00000001;

HashType<String, byte> hashRawArray[110];
HashMap<String, byte> digitMap = HashMap<String, byte>(hashRawArray, 110);

//Assign the Arduino an MAC address
byte MAC_ADDRESS[] = {0xDE, 0xAD, 0xBE, 0xEF, 0xFE, 0xED};
//Assign ourselves an IP address if DHCP fails
IPAddress IP_ADDRESS(192, 168, 1, 110);

//Broken DNS server? Try 122.59.100.88 instead.
const char TEMPERATURE_API_HOST[] = "www2.txttext.com";
const String TEMPERATURE_API_REQUEST = "/api/ardutemp/?q=wellington,nz";

EthernetClient client;

void displayDigit(String digits){
  for (int i = 0; i < sizeof(SEVEN_SEGMENT_PINS) / sizeof(*SEVEN_SEGMENT_PINS); i++){
    byte digit = digitMap.getValueOf(digits.substring(i, i + 1));
    setSegment(digit, SEVEN_SEGMENT_PINS[i]);
  }
}

void setSegment(byte digit, const int segment[8]){
    for (byte mask = B10000000, i = 0; mask > 0; mask >>= 1, i++){
      digitalWrite(segment[i], digit & mask);
    }
}

void updateTemperature(){
  displayDigit("LE0");
  String celcius = getTemperature();
  displayDigit(celcius);
    setSegment(digitMap.getValueOf("celcius"), SEVEN_SEGMENT_PINS[celcius.length()]);
}

void serialEvent(){
  String rxString;
  char rxChar;
  while (Serial.available()){
    while (true){
      if (Serial.available() > 0){
        rxChar = (char)Serial.read();
        if (rxChar == '\n'){
          break;
        }
        rxString += rxChar;
      }
    }
  }
  if (rxString == "refresh"){
    updateTemperature();
  }
  else {
    Serial.println("Displaying digit(s): " + rxString);
    displayDigit(rxString);
  }
  rxString = "";
}

String getTemperature(){
  Serial.print("Retreiving temperature from API.\nInitializing ethernet connection. MAC:");
  for (int i = 0; i < sizeof(MAC_ADDRESS); i++){
    Serial.print(" ");
    Serial.print(MAC_ADDRESS[i], HEX);
  }
  Serial.println();
  
  if (!Ethernet.begin(MAC_ADDRESS)){
    Serial.println("Error while configuring ethernet using DHCP. Requesting IP: " + String(IP_ADDRESS));
    Ethernet.begin(MAC_ADDRESS, IP_ADDRESS);
  }
  
  Serial.println("Waiting 1 sec...");
  delay(1000);
  Serial.println("Connecting...");
  
  if (client.connect(TEMPERATURE_API_HOST, 80)){
    Serial.println("Connected! Sending request: " + String(TEMPERATURE_API_HOST) + String(TEMPERATURE_API_REQUEST));
    //Send HTTP request
    client.println("GET " + String(TEMPERATURE_API_REQUEST));
    client.println("HOST: " + String(TEMPERATURE_API_HOST));
    client.println("Connection: close");
    client.println();
    
    String celcius;
    while (true){
      if (client.available()) {
        char rxChar = (char)client.read();
        celcius += rxChar;
        Serial.print(rxChar);
      }
      else if (!client.connected()){
        Serial.println("\nRetreived temperature. Disconnecting...");
        client.stop();
        return celcius;
      }
    }
  }
  else{
    Serial.println("Connection failed.");
  }
}

void setup(){
  digitMap[0]("0", B11111100);
  digitMap[1]("1", B01100000);
  digitMap[2]("2", B11011010);
  digitMap[3]("3", B11110010);
  digitMap[4]("4", B01100110);
  digitMap[5]("5", B10110110);
  digitMap[6]("6", B10111110);
  digitMap[7]("7", B11100000);
  digitMap[8]("8", B11111110);
  digitMap[9]("9", B11110110);
  digitMap[10]("A", B11101110);
  digitMap[11]("b", B00111110);
  digitMap[12]("C", B10011100);
  digitMap[13]("c", B00011010);
  digitMap[14]("d", B01111010);
  digitMap[15]("E", B10011110);
  digitMap[16]("F", B10001110);
  digitMap[17]("H", B01101110);
  digitMap[18]("h", B00101110);
  digitMap[19]("L", B00011100);
  digitMap[20]("n", B00101010);
  digitMap[21]("o", B00111010);
  digitMap[22]("r", B00001010);
  digitMap[23]("P", B11001110);
  digitMap[24]("u", B00111000);
  digitMap[100]("celcius", B10011110); //Requires display to be vertically flipped.
  
  Serial.begin(57600);
  for (int i = 0; i < sizeof(SEVEN_SEGMENT_PINS) / 8; i++){
    for (int j = 0; j < 8; j++){
      pinMode(SEVEN_SEGMENT_PINS[i][j], OUTPUT);
    }
  }
  updateTemperature();
}

void loop(){
}

/*
                                                                @`````````````````````````````````@                                                                    
                                                               @```````````````````````````````````@                                                                   
                                                              @`````````````````````````````````````@                                                                  
                                                             @```````````````````````````````````````#                                                                 
                                                            @`````````````````````````````````````````#                                                                
                                                           @`````````````````````@.````````````````````#                                                               
                                                          @``````````````````````;@`````````````````````#                                                              
                                                         @``````````````````````@`@``````````````````````+                                                             
                                                        @```````````````````````+`@'``````````````````````+                                                            
                                                         @`````````````````````,``.@`````````````````````@                                                             
                                                      @:  @````````````````````@@@@@````````````````````@  '@                                                          
                                                     @``:  @```````````````````;```@@``````````````````@  +``@                                                         
                                                    @````;  @`````````````````;`````@`````````````````@  +````@                                                        
                                                   @``````;  @```````````````,@,```:@'```````````````@  +``````@                                                       
                                                  @````````'  @`````````````````````````````````````@  #````````@                                                      
                                                 @``````````'  @```````````````````````````````````@  #``````````@                                                     
                                                @````````````'  @`````````````````````````````````@  #````````````@                                                    
                                               @``````````````+  ;;;;;;;;;;;;;;;;;;;;;;;;;;;;;;;;;  #``````````````@                                                   
                                              @````````````````+                                   @````````````````@                                                  
                                              :````````````````@                                   @````````````````'                                                  
                                              :````````````````@                                   @````````````````'                                                  
                                              :````````````````@                                   @````````````````'                                                  
                                              :````````````````@                                   @````````````````'                                                  
                                              :````````````````@                                   @````````````````'                                                  
                                              :````````````````@                                   @````````````````'                                                  
                                              :````````````````@                                   @````````````````'                                                  
                                              :````````````````@                                   @````````````````'                                                  
                                              :````````````````@                                   @````````````````'                                                  
                                              :````,@####+`````@                                   @````:@++@@``````'                                                  
                                              :`````@,```+`````@                                   @`````@```;@`````'                                                  
                                              :`````@,`````````@                                   @`````@```:@`````'                                                  
                                              :`````@,``+``````@                                   @`````@``.@``````'                                                  
                                              :`````@@@@+``````@                                   @`````@``.@#`````'                                                  
                                              :`````@,``+``````@                                   @`````@````@:````'                                                  
                                              :`````@,`````````@                                   @`````@````@'````'                                                  
                                              :`````@,`````````@                                   @`````@````@`````'                                                  
                                              :````@@@@````````@                                   @````@@@@@;``````'                                                  
                                              :````````````````@                                   @````````````````'                                                  
                                              :````````````````@                                   @````````````````'                                                  
                                              :````````````````@                                   @````````````````'                                                  
                                              :````````````````@                                   @````````````````'                                                  
                                              :````````````````@                                   @````````````````'                                                  
                                              :````````````````@                                   @````````````````'                                                  
                                              '````````````````@                                   @````````````````@                                                  
                                              .,``````````````@                                     @``````````````;`                                                  
                                               .,````````````@  ;''''''''''''''''''''''''''''''''':  @````````````;`                                                   
                                                .,``````````@  ;```````````````````````````````````:  @``````````;`                                                    
                                                 .,````````@  ;````````````````````````````````````.,  @````````;`                                                     
                                                  .,``````@  ;``````````````````````````````````````.,  @``````;`                                                      
                                                   .,````@  ;````````````````````````````````````````..  @````;`                                                       
                                                    ..``@  ;``````````````````````````````````````````..  @``;`                                                        
                                                     ..@  ;```````````````````+@```#:``````````````````,.  @;`                                                         
                                                      .  ;```````````````````'@`````:```````````````````,`  `                                                          
                                                        ;````````````````````@.``````````````````````````,`                                                            
                                                        `:```````````````````@```````````````````````````#                                                             
                                                      `  `;``````````````````@````;;;,``````````````````#                                                              
                                                     `:@  `;`````````````````@.````'@``````````````````+   @'                                                          
                                                    `:``@  `;````````````````;@````'@`````````````````+   @``'                                                         
                                                   .,````@  `;````````````````'@```#@````````````````+   @````'                                                        
                                                  .,``````@  `;`````````````````````````````````````'   @``````;`                                                      
                                                 .,````````@  `;```````````````````````````````````'   @````````;`                                                     
                                                ,.``````````@  `;`````````````````````````````````;   #``````````:`                                                    
                                               ,.````````````@  `@@@@@@@@@@@@@@@@@@@@@@@@@@@@@@@@@   #````````````:`                                                   
                                              :.``````````````@                                     #``````````````,`                                                  
                                              :````````````````@                                   @````````````````+                                                  
                                              :````````````````@                                   @````````````````'                                                  
                                              :````````````````@                                   @````````````````'                                                  
                                              :````````````````@                                   @````````````````'                                                  
                                              :````````````````@                                   @````````````````'                                                  
                                              :````````````````@                                   @````````````````'                                                  
                                              :````````````````@                                   @````````````````'                                                  
                                              :````````````````@                                   @````````````````'                                                  
                                              :````````````````@                                   @````````````````'                                                  
                                              :````@@@@@@``````@                                   @``````.#@#:`````'                                                  
                                              :`````@``````````@                                   @`````@.`````````'                                                  
                                              :`````@``````````@                                   @````@#``````````'                                                  
                                              :`````@``.```````@                                   @````@```````````'                                                  
                                              :`````@@@@```````@                                   @````@```````````'                                                  
                                              :`````@``,```````@                                   @````@```````````'                                                  
                                              :`````@``````````@                                   @````@;``````````'                                                  
                                              :`````@````@`````@                                   @`````@`````:````'                                                  
                                              :````:@####@`````@                                   @``````@#;#@,````'                                                  
                                              :````````````````@                                   @````````````````'                                                  
                                              :````````````````@                                   @````````````````'                                                  
                                              :````````````````@                                   @````````````````'                                                  
                                              :````````````````@                                   @````````````````'                                                  
                                              :````````````````@                                   @````````````````'                                                  
                                              :````````````````@                                   @````````````````'                                                  
                                              :````````````````@                                   @````````````````'         ,+@@'                                    
                                              @````````````````;                                   #````````````````@       @#`````,@#                                 
                                               @``````````````;  .................................  #``````````````@      #+``````````@.                               
                                                @````````````;  @`````````````````````````````````@  #````````````@      @.````````````#:                              
                                                 @``````````'  @```````````````````````````````````@  #``````````@      #```````````````#`                             
                                                  @````````'  @`````````````````````````````````````@  #````````@      `+````````````````@                             
                                                   @``````'  @```````````````````````````````````````@  #``````@       @`````````````````.:                            
                                                    @````'  @`````````````````````````````````````````@  #````@        #``````````````````@                            
                                                     @``'  @`````````````````+@+#@@````````````````````@  #``@        ,.```@``+#``@``@````@                            
                                                      @'  @``````````````````;@````@````````````````````@  #@         +````@```@``@``@````+                            
                                                         @```````````````````;@````+@````````````````````@            +````@```':`@``@````+                            
                                                        @````````````````````;@`````@`````````````````````#           ;````@```+,`@,``````@                            
                                                         @```````````````````;@`````@````````````````````@             ;```@```@``@```````@                            
                                                          @``````````````````;@````.@```````````````````@              @```@::@```@```````#                            
                                                           @`````````````````;@````##``````````````````@               +`````````````````#                             
                                                            @````````````````;@```:@``````````````````@                 @````````````````#                             
                                                             @``````````````#@@@@#.``````````````````@                   @``````````````@                              
                                                              @`````````````````````````````````````@                    `@```````````.@                               
                                                               @```````````````````````````````````@                       @'````````@'                                
                                                                @`````````````````````````````````@                          #@@+#@@;                                  
                                                                 `````````````````````````````````                                                       
*/
